## CMakeLists.txt
```
# SPDX-License-Identifier: Apache-2.0
cmake_minimum_required(VERSION 3.20.0)
include(${CMAKE_CURRENT_LIST_DIR}/../../cmake/prepare.cmake)
find_package(Zephyr REQUIRED HINTS $ENV{ZEPHYR_BASE})
project(dust_usb_gateway)
set(generated ${CMAKE_CURRENT_BINARY_DIR}/generated)
set(message_names usb_raw_frame_queue)
foreach(name IN LISTS message_names)
 list(APPEND message_inputs ${DUST_ADAPTER_ROOT}/interfaces/${name}.msg)
 list(APPEND message_headers ${generated}/msg/${name}.hpp)
endforeach()
add_custom_command(OUTPUT ${generated}/msg/messages_generated.cpp ${message_headers}
 COMMAND ${PYTHON_EXECUTABLE} ${DUST_ADAPTER_ROOT}/tools/generate_messages.py
 --output-dir ${generated}/msg --source-output ${generated}/msg/messages_generated.cpp ${message_inputs}
 DEPENDS ${DUST_ADAPTER_ROOT}/tools/generate_messages.py ${message_inputs}
 VERBATIM)
set(DUST_ADAPTER_CAN_CONFIG "${DUST_ADAPTER_ROOT}/config/can_devices.yaml" CACHE FILEPATH "MCU CAN device/protection configuration")
add_custom_command(OUTPUT ${generated}/can_profile_generated.hpp
 COMMAND ${PYTHON_EXECUTABLE} ${DUST_ADAPTER_ROOT}/tools/generate_can_profile.py
 --input ${DUST_ADAPTER_CAN_CONFIG}
 --output ${generated}/can_profile_generated.hpp
 DEPENDS ${DUST_ADAPTER_ROOT}/tools/generate_can_profile.py
 ${DUST_ADAPTER_CAN_CONFIG}
 VERBATIM)
target_sources(app PRIVATE src/main.cpp src/peripherals.cpp
 ${DUST_ADAPTER_ROOT}/drivers/can/can_dispatch.cpp
 ${DUST_ADAPTER_ROOT}/drivers/usb/usb_session.cpp
 ${DUST_ADAPTER_ROOT}/drivers/imu/onboard_imu.cpp
 ${generated}/msg/messages_generated.cpp ${message_headers}
 ${generated}/can_profile_generated.hpp)
target_sources_ifdef(CONFIG_WBR_UART10_LINE_IDLE app PRIVATE src/uart10_line_idle.cpp)
target_include_directories(app PRIVATE ${DUST_ADAPTER_ROOT}/include ${generated})
target_compile_definitions(app PRIVATE WBR_USB_RAW_OUT_BYTES=128)
zephyr_include_directories(${DUST_HPM_SUPPORT_DIR}/samples/cherryusb/config)
```

## prj.conf
```kconfig
CONFIG_CPP=y
CONFIG_STD_CPP17=y
CONFIG_REQUIRES_FULL_LIBCPP=y
CONFIG_CAN=y
CONFIG_CAN_FD_MODE=n
CONFIG_SERIAL=y
CONFIG_UART_ASYNC_API=y
CONFIG_UART_INTERRUPT_DRIVEN=y
CONFIG_DMA=y
CONFIG_SPI=y
CONFIG_SPI_ASYNC=y
CONFIG_SPI_HPMICRO=y
CONFIG_SPI_HPM_SPI_DMA=y
CONFIG_SPI_HPM_SPI_INTERRUPT=n
CONFIG_GPIO=y
CONFIG_CHERRYUSB=y
CONFIG_CHERRYUSB_DEVICE=y
CONFIG_CHERRYUSB_DEVICE_SPEED_HS=y
CONFIG_CHERRYUSB_DEVICE_HPM=y
CONFIG_MAIN_STACK_SIZE=4096
CONFIG_SYS_CLOCK_TICKS_PER_SEC=10000
CONFIG_ISR_STACK_SIZE=4096
CONFIG_HPM_PLIC_PRIORITY_NESTING=y
CONFIG_HPM_PLIC_MAX_NESTING_DEPTH=4
CONFIG_LOG=n
CONFIG_PRINTK=n
CONFIG_BOOT_BANNER=n
CONFIG_UART_CONSOLE=n
CONFIG_STDOUT_CONSOLE=n
CONFIG_WBR_CONTROL_ONBOARD_IMU_RAW=y

# Required UART10 partial publication; not a diagnostic option.
CONFIG_WBR_UART10_LINE_IDLE=y

# Adapter firmware has no local filesystem or FatFs dependency.
CONFIG_FILE_SYSTEM=n
```

## src/main.cpp
```c
/* SPDX-License-Identifier: Apache-2.0 */
#include "peripherals.h"
#include <cstring>
#include <dust_adapter/can_dispatch.hpp>
#include <dust_adapter/firmware_can_profile.hpp>
#include <dust_adapter/usb_session.hpp>
#include <zephyr/kernel.h>
#include <zephyr/sys/atomic.h>

namespace {
namespace wire = dust::wire;
using wire::Packet;
struct QueuedCan {
  platform::CanReceiveFrame frame;
  uint32_t session;
};
K_MSGQ_DEFINE(can_packets, sizeof(QueuedCan), 128, 4);
K_MSGQ_DEFINE(peripheral_packets, sizeof(Packet), 128, 4);
K_MSGQ_DEFINE(replies, sizeof(Packet), 16, 4);
K_SEM_DEFINE(uplink_event, 0, 1);
K_THREAD_STACK_DEFINE(uplink_stack, 2048);
k_thread uplink_thread;
atomic_t session_id{}, can_drops{}, peripheral_drops{}, reply_drops{},
    usb_send_errors{};
wire::SessionPolicy policy;
wire::Record uart_stop_actions[wire::kMaxRecords]{};
size_t uart_stop_count = 0;
uint32_t capabilities = 0, rejected = 0, stop_errors = 0, session_epoch = 0;
wire::StopReason last_stop = wire::StopReason::None;
uint32_t NowUs() { return k_cyc_to_us_floor64(k_cycle_get_64()); }

void QueueReply(const Packet &packet) {
  if (k_msgq_put(&replies, &packet, K_NO_WAIT))
    atomic_inc(&reply_drops);
  k_sem_give(&uplink_event);
}
void Result(const wire::Request &request, int result) {
  Packet reply{};
  wire::Header(reply.data(), wire::Kind::Result, 0, policy.Session());
  wire::Put32(reply.data() + 16, wire::U32(request.data() + 4));
  reply[20] = request[9];
  reply[21] = policy.Armed();
  wire::Put32(reply.data() + 24, uint32_t(result));
  QueueReply(reply);
}
void Close(wire::StopReason reason) {
  // Clear publication first; old peripheral records cannot cross into a new
  // session.
  atomic_clear(&session_id);
  // Protection is MCU configuration, not disposable session/host state.
  const auto &frames = dust::can_profile::kProtectionFrames;
  if (platform::ReplaceCanTraffic(frames.data(), frames.size()))
    ++stop_errors;
  gateway::DiscardUartWrites();
  for (size_t i = 0; i < uart_stop_count; ++i) {
    const auto &action = uart_stop_actions[i];
    if (gateway::SubmitUart(action.channel, action.data, action.length))
      ++stop_errors;
  }
  uart_stop_count = 0;
  policy.Close();
  last_stop = reason;
}
void ReceiveCan(const platform::CanReceiveFrame &frame) {
  const uint32_t session = gateway::Session();
  if (!session)
    return;
  const QueuedCan queued{frame, session};
  if (k_msgq_put(&can_packets, &queued, K_NO_WAIT))
    atomic_inc(&can_drops);
  else
    k_sem_give(&uplink_event);
}
bool TakeCan(Packet &packet) {
  const uint32_t session = gateway::Session();
  if (!session)
    return false;
  QueuedCan queued{};
  unsigned count = 0;
  while (count < 2 && !k_msgq_get(&can_packets, &queued, K_NO_WAIT)) {
    if (queued.session != session)
      continue;
    auto *p = packet.data() + 16 + count * 24;
    wire::Encode(p, queued.frame.record);
    wire::Put32(p + 16, queued.frame.timestamp_us);
    wire::Put32(p + 20, queued.frame.sequence);
    ++count;
  }
  if (!count)
    return false;
  wire::Header(packet.data(), wire::Kind::Can, 0, session);
  packet[10] = count;
  return true;
}
void Uplink(void *, void *, void *) {
  bool peripheral_turn = false;
  for (;;) {
    Packet packet{};
    bool found = !k_msgq_get(&replies, &packet, K_NO_WAIT);
    if (!found && peripheral_turn)
      found = !k_msgq_get(&peripheral_packets, &packet, K_NO_WAIT);
    if (!found)
      found = TakeCan(packet);
    if (!found)
      found = !k_msgq_get(&peripheral_packets, &packet, K_NO_WAIT);
    if (!found) {
      k_sem_take(&uplink_event, K_FOREVER);
      continue;
    }
    peripheral_turn = !peripheral_turn;
    if (!gateway::Session() ||
        wire::U32(packet.data() + 12) != gateway::Session())
      continue;
    wire::Put32(packet.data() + 4, NowUs());
    if (platform::SendUsb(packet.data(), packet.size()) != int(packet.size()) ||
        platform::WaitUsbTxComplete(20))
      atomic_inc(&usb_send_errors);
  }
}
int ConfigureSafety(const wire::Request &request) {
  if (!dust::can_profile::AcceptsSafetyRequest(request))
    return -EACCES;
  if (!policy.Fresh(wire::U32(request.data() + 4)))
    return -ESTALE;
  wire::Record uart_actions[wire::kMaxRecords]{};
  size_t uart_count = 0;
  for (unsigned i = 0; i < request[10]; ++i) {
    const auto action = wire::Decode(request.data() + 32 + i * 16);
    if (action.flags != wire::kUartAction)
      continue;
    if (!gateway::UartAvailable(action.channel))
      return -ENODEV;
    uart_actions[uart_count++] = action;
  }
  if (!policy.Configure(wire::U32(request.data() + 16)))
    return -EINVAL;
  uart_stop_count = uart_count;
  std::memcpy(uart_stop_actions, uart_actions, sizeof(uart_actions));
  policy.Observe(wire::U32(request.data() + 4));
  return 0;
}
int Forward(const wire::Request &request) {
  if (!policy.Armed() || policy.Expired(NowUs()))
    return -EACCES;
  if (!policy.Fresh(wire::U32(request.data() + 4)))
    return -ESTALE;
  int result;
  if (request[9] == uint8_t(wire::Kind::UartWrite)) {
    const size_t size = request[11];
    if (!size || size > wire::kMaxUartWrite ||
        !wire::Zero(request.data() + 16, 16) ||
        !wire::Zero(request.data() + 32 + size, request.size() - 32 - size))
      return -EINVAL;
    result = gateway::SubmitUart(request[10], request.data() + 32, size);
  } else {
    if (!wire::ValidRecords(request))
      return -EINVAL;
    wire::Record frames[wire::kMaxRecords]{};
    for (unsigned i = 0; i < request[10]; ++i) {
      frames[i] = wire::Decode(request.data() + 32 + i * 16);
      if (!platform::CanAvailable(frames[i].channel))
        return -ENODEV;
    }
    result = platform::SubmitCanRecords(frames, request[10]);
  }
  if (!result && !policy.Accept(wire::U32(request.data() + 4), NowUs())) {
    Close(wire::StopReason::LeaseExpired);
    return -ETIMEDOUT;
  }
  return result;
}
void Status(const wire::Request &request) {
  Packet reply{};
  wire::Header(reply.data(), wire::Kind::Status, 0, policy.Session());
  reply[10] = request[10];
  reply[11] = request[11];
  if (!request[10]) {
    reply[16] = policy.Armed();
    reply[17] = policy.Configured();
    reply[18] = uint8_t(last_stop);
    wire::Put32(reply.data() + 20, rejected);
    wire::Put32(reply.data() + 24, atomic_get(&can_drops));
    wire::Put32(reply.data() + 28, atomic_get(&peripheral_drops));
    wire::Put32(reply.data() + 32, stop_errors);
    wire::Put32(reply.data() + 36, atomic_get(&reply_drops));
    wire::Put32(reply.data() + 40, atomic_get(&usb_send_errors));
    platform::UsbSessionStats stats{};
    platform::ReadUsbSessionStats(&stats);
    wire::Put32(reply.data() + 44, stats.receive_queue_drops);
    wire::Put32(reply.data() + 48, stats.endpoint_errors);
    wire::Put32(reply.data() + 52, dust::can_profile::kProtectionSignature);
    wire::Put32(reply.data() + 56, dust::can_profile::kCommandTimeoutUs);
  } else if (request[10] == 1) {
    const auto stats = platform::ReadCanStats(request[11]);
    const uint32_t values[] = {
        stats.received, stats.submitted, stats.completed,
        stats.errors,   stats.dropped,   stats.queue_depth,
        stats.state,    stats.tx_errors, stats.rx_errors};
    for (unsigned i = 0; i < 9; ++i)
      wire::Put32(reply.data() + 16 + 4 * i, values[i]);
  } else if (request[10] == 2) {
    const auto stats = gateway::ReadUartStats(request[11]);
    wire::Put32(reply.data() + 16, stats.received);
    wire::Put32(reply.data() + 20, stats.dropped);
    wire::Put32(reply.data() + 24, stats.tx_completed);
    wire::Put32(reply.data() + 28, stats.tx_errors);
  }
  QueueReply(reply);
}
void Handle(const wire::Request &request, size_t length) {
  if (!wire::HasHeader(request.data(), length)) {
    ++rejected;
    return;
  }
  const auto kind = wire::Kind(request[9]);
  if (kind == wire::Kind::Hello && length == wire::kOutBytes && !request[10] &&
      !request[11] && wire::Zero(request.data() + 16, 112)) {
    const uint32_t session = wire::U32(request.data() + 12);
    if (!session) {
      ++rejected;
      return;
    }
    if (policy.Session())
      Close(wire::StopReason::Replaced);
    policy.Open(session);
    session_epoch = platform::UsbConnectionEpoch();
    k_msgq_purge(&can_packets);
    k_msgq_purge(&peripheral_packets);
    k_msgq_purge(&replies);
    atomic_set(&session_id, session);
    Packet ready{};
    wire::Header(ready.data(), wire::Kind::Ready, 0, session);
    wire::Put32(ready.data() + 16, capabilities);
    wire::Put32(ready.data() + 20, wire::kOutBytes);
    wire::Put32(ready.data() + 24, wire::kInBytes);
    wire::Put32(ready.data() + 28, platform::CanChannelMask());
    ready[32] = wire::kMaxRecords;
    ready[33] = dust::can_profile::kProtectionFrames.size();
    ready[34] = wire::kFirmwareCanProtection;
    wire::Put32(ready.data() + 36, dust::can_profile::kProtectionSignature);
    wire::Put32(ready.data() + 40, dust::can_profile::kCommandTimeoutUs);
    QueueReply(ready);
    return;
  }
  if (length != wire::kOutBytes || !policy.Session() ||
      wire::U32(request.data() + 12) != policy.Session()) {
    ++rejected;
    return;
  }
  int rc = 0;
  switch (kind) {
  case wire::Kind::ConfigureSafety:
    rc = ConfigureSafety(request);
    Result(request, rc);
    break;
  case wire::Kind::Arm:
    if (request[10] || request[11] || !wire::Zero(request.data() + 16, 112) ||
        !policy.Arm(wire::U32(request.data() + 4), NowUs()))
      rc = -EINVAL;
    Result(request, rc);
    break;
  case wire::Kind::Transmit:
  case wire::Kind::UartWrite:
    rc = Forward(request);
    if (rc)
      Result(request, rc); // successful data traffic has no periodic ACK
    break;
  case wire::Kind::Heartbeat:
    if (request[10] || request[11] || !wire::Zero(request.data() + 16, 112) ||
        !policy.Accept(wire::U32(request.data() + 4), NowUs()))
      rc = -EINVAL;
    break;
  case wire::Kind::Stop:
    Close(wire::StopReason::Explicit);
    break;
  case wire::Kind::Status:
    if (request[10] > 2 || !wire::Zero(request.data() + 16, 112))
      rc = -EINVAL;
    else
      Status(request);
    break;
  default:
    rc = -ENOTSUP;
    Result(request, rc);
    break;
  }
  if (rc)
    ++rejected;
  // Queue admission failure must never silently leave an armed controller
  // running.
  if ((rc == -ENOSPC || rc == -EIO) && policy.Armed())
    Close(wire::StopReason::TransportError);
}
} // namespace

namespace gateway {
uint32_t Session() { return uint32_t(atomic_get(&session_id)); }
bool PublishPeripheral(const Packet &packet) {
  if (!Session())
    return false;
  if (k_msgq_put(&peripheral_packets, &packet, K_NO_WAIT)) {
    atomic_inc(&peripheral_drops);
    return false;
  }
  k_sem_give(&uplink_event);
  return true;
}
} // namespace gateway

int main() {
  k_thread_priority_set(k_current_get(), 7);
  if (platform::InitializeCanDispatch(ReceiveCan))
    return -1;
  if (dust::can_profile::kProtectOnBoot) {
    const auto &frames = dust::can_profile::kProtectionFrames;
    if (platform::ReplaceCanTraffic(frames.data(), frames.size()))
      ++stop_errors;
  }
  capabilities = 1 | gateway::StartPeripherals();
  if (platform::InitializeUsbSession())
    return -1;
  k_thread_create(&uplink_thread, uplink_stack,
                  K_THREAD_STACK_SIZEOF(uplink_stack), Uplink, nullptr, nullptr,
                  nullptr, 7, 0, K_NO_WAIT);
  for (;;) {
    // Check even under continuous incoming traffic; malformed packets cannot
    // keep a lease alive.
    if (policy.Session() && (!platform::IsUsbConfigured() ||
                             platform::UsbConnectionEpoch() != session_epoch))
      Close(wire::StopReason::UsbLost);
    else if (policy.Expired(NowUs()))
      Close(wire::StopReason::LeaseExpired);
    const bool output_fault =
        platform::TakeCanFault() | gateway::TakePeripheralFault();
    if (output_fault && policy.Armed())
      Close(wire::StopReason::TransportError);
    static uint32_t last_usb_errors = 0, last_out_drops = 0,
                    last_endpoint_errors = 0;
    const uint32_t usb_errors = atomic_get(&usb_send_errors);
    platform::UsbSessionStats usb_stats{};
    platform::ReadUsbSessionStats(&usb_stats);
    const bool transport_fault =
        usb_errors != last_usb_errors ||
        usb_stats.receive_queue_drops != last_out_drops ||
        usb_stats.endpoint_errors != last_endpoint_errors;
    if (transport_fault && policy.Armed())
      Close(wire::StopReason::TransportError);
    last_usb_errors = usb_errors;
    last_out_drops = usb_stats.receive_queue_drops;
    last_endpoint_errors = usb_stats.endpoint_errors;
    wire::Request request{};
    size_t length = 0;
    if (!platform::ReceiveUsb(request.data(), request.size(), &length, 1)) {
      if (policy.Session() && platform::UsbConnectionEpoch() != session_epoch)
        Close(wire::StopReason::UsbLost);
      if (policy.Expired(NowUs()))
        Close(wire::StopReason::LeaseExpired);
      Handle(request, length);
    }
  }
}
```

## src/peripherals.cpp
```c
/* SPDX-License-Identifier: Apache-2.0 */
#include "peripherals.h"
#include <algorithm>
#include <cstring>
#include <drivers/uart_hpmicro.h>
#include <dust_adapter/onboard_imu.hpp>
#include <hpm_l1c_drv.h>
#include <zephyr/device.h>
#include <zephyr/devicetree.h>
#include <zephyr/drivers/uart.h>
#include <zephyr/irq.h>
#include <zephyr/kernel.h>

#ifdef CONFIG_WBR_UART10_LINE_IDLE
int Uart10LineIdleStart(const device *, uint32_t);
#endif

namespace {
namespace wire = dust::wire;
constexpr size_t kChunkBytes = 40, kBufferBytes = 128, kRingBytes = 4096;
constexpr int32_t kUartRxTimeoutUs = 1000;
__attribute__((section(".nocache"),
               aligned(64))) uint8_t uart2_ring[kRingBytes];
__attribute__((aligned(64))) uint8_t uart_buffers[2][2][kBufferBytes];
#ifdef CONFIG_WBR_UART10_LINE_IDLE
__attribute__((section(".nocache"),
               aligned(64))) uint8_t uart10_idle_buffers[2][kBufferBytes];
#endif
K_THREAD_STACK_DEFINE(uart_stack, 2048);
K_THREAD_STACK_DEFINE(imu_stack, 2048);
k_thread uart_thread, imu_thread;
modules::OnboardImu onboard;
struct UartPort {
  const device *dev = nullptr;
  wire::Port port{};
  unsigned buffer_set = 0, next_buffer = 1;
  uint32_t sequence = 0;
  atomic_t received{}, dropped{}, tx_errors{}, tx_completed{};
  bool available = false;
  uint8_t *Buffer(unsigned index) const {
#ifdef CONFIG_WBR_UART10_LINE_IDLE
    if (port == wire::Port::Uart10)
      return uart10_idle_buffers[index];
#endif
    return uart_buffers[buffer_set][index];
  }
  void Publish(const uint8_t *data, size_t size) {
    while (size) {
      const size_t count = std::min(size, kChunkBytes);
      wire::Packet packet{};
      const uint32_t now = k_cyc_to_us_floor64(k_cycle_get_64());
      wire::Header(packet.data(), wire::Kind::Uart, now, gateway::Session());
      packet[10] = uint8_t(port);
      packet[11] = count;
      wire::Put32(packet.data() + 16, sequence++);
      atomic_inc(&received);
      wire::Put32(packet.data() + 20, now);
      std::memcpy(packet.data() + 24, data, count);
      if (gateway::Session() && !gateway::PublishPeripheral(packet))
        atomic_inc(&dropped);
      data += count;
      size -= count;
    }
  }
};
UartPort uart10{DEVICE_DT_GET(DT_NODELABEL(uart10)), wire::Port::Uart10, 0};
UartPort uart2{DEVICE_DT_GET(DT_NODELABEL(uart2)), wire::Port::Uart2, 0};
#if DT_NODE_HAS_STATUS(DT_NODELABEL(uart3), okay)
UartPort uart3{DEVICE_DT_GET(DT_NODELABEL(uart3)), wire::Port::Uart3, 1};
#endif

void UartTransmitDone(UartPort &, bool);

void AsyncUart(const device *dev, uart_event *event, void *user) {
  auto &port = *static_cast<UartPort *>(user);
  switch (event->type) {
  case UART_TX_DONE:
  case UART_TX_ABORTED:
    UartTransmitDone(port, event->type == UART_TX_ABORTED);
    break;
  case UART_RX_RDY: {
    const auto *data = event->data.rx.buf + event->data.rx.offset;
    const uint32_t begin =
        HPM_L1C_CACHELINE_ALIGN_DOWN(reinterpret_cast<uint32_t>(data));
    const uint32_t end = HPM_L1C_CACHELINE_ALIGN_UP(
        reinterpret_cast<uint32_t>(data) + event->data.rx.len);
    if (!(IS_ENABLED(CONFIG_WBR_UART10_LINE_IDLE) &&
          port.port == wire::Port::Uart10))
      l1c_dc_invalidate(begin, end - begin);
    port.Publish(data, event->data.rx.len);
    break;
  }
  case UART_RX_BUF_RELEASED:
    break;
  case UART_RX_BUF_REQUEST: {
    const unsigned next = port.next_buffer;
    port.next_buffer ^= 1;
    (void)uart_rx_buf_rsp(dev, port.Buffer(next), kBufferBytes);
    break;
  }
  case UART_RX_DISABLED:
    port.next_buffer = 1;
    (void)uart_rx_enable(dev, port.Buffer(0), kBufferBytes, kUartRxTimeoutUs);
    break;
  case UART_RX_STOPPED:
    // Advance stream sequence even if no chunk is emitted. Host discards a
    // partially assembled frame after an acquisition discontinuity.
    ++port.sequence;
    break;
  default:
    break;
  }
}

bool StartAsync(UartPort &port) {
  return device_is_ready(port.dev) &&
         uart_callback_set(port.dev, AsyncUart, &port) == 0 &&
         uart_rx_enable(port.dev, port.Buffer(0), kBufferBytes,
                        kUartRxTimeoutUs) == 0;
}
void Uart2Loop(void *, void *, void *) {
  size_t read = 0, observed = 0, available = 0;
  uint32_t previous_poll = k_uptime_get_32();
  for (;;) {
    size_t position = 0;
    const uint32_t now = k_uptime_get_32();
    if (now - previous_poll > 20) {
      // A whole ring can be overwritten after a prolonged scheduling
      // stall; do not forward mixed old/new bytes as a valid stream.
      ++uart2.sequence;
      if (uart_hpm_rx_circular_get_position(uart2.dev, &position) == 0)
        read = observed = position % kRingBytes;
      available = 0;
    }
    previous_poll = now;
    if (uart_hpm_rx_circular_get_position(uart2.dev, &position) == 0 &&
        position <= kRingBytes) {
      position %= kRingBytes;
      available += (position + kRingBytes - observed) % kRingBytes;
      observed = position;
      // Retain the proven DMA outstanding-write guard from production.
      size_t consume = available > 16 ? available - 16 : 0;
      while (consume) {
        const size_t count = std::min(consume, kRingBytes - read);
        uart2.Publish(uart2_ring + read, count);
        read = (read + count) % kRingBytes;
        available -= count;
        consume -= count;
      }
    }
    k_sleep(K_MSEC(1));
  }
}
void ImuLoop(void *, void *, void *) {
  uint32_t sequence = 0;
  for (;;) {
    modules::OnboardImu::Burst burst{};
    if (onboard.TryTakeCompleted(burst)) {
      wire::Packet packet{};
      const uint32_t now = k_cyc_to_us_floor64(k_cycle_get_64());
      wire::Header(packet.data(), wire::Kind::Imu, now, gateway::Session());
      packet[10] = modules::OnboardImu::kBurstTransferSize;
      const uint32_t age =
          k_cyc_to_us_floor32(k_cycle_get_32() - burst.data_ready_cycle);
      wire::Put32(packet.data() + 16, now - age);
      wire::Put32(packet.data() + 52, sequence++);
      std::memcpy(packet.data() + 20, burst.rx, sizeof(burst.rx));
      std::memcpy(packet.data() + 48, &burst.temperature_c, sizeof(float));
      gateway::PublishPeripheral(packet);
    }
    (void)onboard.TryStartAsync();
    k_usleep(100);
  }
}
struct UartWrite {
  uint8_t length;
  uint8_t data[wire::kMaxUartWrite];
};
struct UartTx {
  k_msgq queue;
  alignas(4) char storage[8 * sizeof(UartWrite)];
  atomic_t busy{};
  uint32_t started_us = 0;
};
UartTx transmitters[3];
__attribute__((section(".nocache"), aligned(64))) uint8_t tx_buffers[3][128];
K_MUTEX_DEFINE(tx_mutex);
K_SEM_DEFINE(tx_wake, 0, 1);
K_THREAD_STACK_DEFINE(tx_stack, 1536);
k_thread tx_thread;
atomic_t peripheral_fault;
UartPort *ports[] = {&uart10, &uart2,
#if DT_NODE_HAS_STATUS(DT_NODELABEL(uart3), okay)
                     &uart3
#else
                     nullptr
#endif
};
void UartTransmitDone(UartPort &port, bool error) {
  auto &tx = transmitters[unsigned(port.port) - 1];
  if (error) {
    atomic_inc(&port.tx_errors);
    atomic_set(&peripheral_fault, 1);
  } else
    atomic_inc(&port.tx_completed);
  atomic_clear(&tx.busy);
  k_sem_give(&tx_wake);
}
void UartTransmitLoop(void *, void *, void *) {
  for (;;) {
    k_sem_take(&tx_wake, K_MSEC(1));
    k_mutex_lock(&tx_mutex, K_FOREVER);
    for (unsigned i = 0; i < 3; ++i) {
      auto *port = ports[i];
      if (!port || !port->available)
        continue;
      auto &tx = transmitters[i];
      if (atomic_get(&tx.busy)) {
        const uint32_t now = k_cyc_to_us_floor64(k_cycle_get_64());
        if (uint32_t(now - tx.started_us) > 100000) {
          atomic_inc(&port->tx_errors);
          atomic_set(&peripheral_fault, 1);
          (void)uart_tx_abort(port->dev);
        }
        continue;
      }
      // HPM UART_TX_DONE marks DMA completion, before FIFO/shift-register
      // drain. uart_tx() resets the FIFO; never start the next write until it
      // is empty.
      if (!uart_irq_tx_complete(port->dev))
        continue;
      UartWrite write{};
      if (k_msgq_get(&tx.queue, &write, K_NO_WAIT))
        continue;
      std::memcpy(tx_buffers[i], write.data, write.length);
      tx.started_us = k_cyc_to_us_floor64(k_cycle_get_64());
      atomic_set(&tx.busy, 1);
      if (uart_tx(port->dev, tx_buffers[i], write.length, 100000)) {
        atomic_inc(&port->tx_errors);
        atomic_set(&peripheral_fault, 1);
        atomic_clear(&tx.busy);
      }
    }
    k_mutex_unlock(&tx_mutex);
  }
}

} // namespace

namespace gateway {
uint32_t StartPeripherals() {
  uint32_t capabilities = 0;
  for (auto &tx : transmitters)
    k_msgq_init(&tx.queue, tx.storage, sizeof(UartWrite), 8);
#ifdef CONFIG_WBR_UART10_LINE_IDLE
  if (!device_is_ready(uart10.dev) ||
      uart_hpm_rx_line_idle_enable(uart10.dev) != 0)
    return 0;
#endif
  if (StartAsync(uart10)) {
    uart10.available = true;
    capabilities |= 2;
#ifdef CONFIG_WBR_UART10_LINE_IDLE
    if (Uart10LineIdleStart(uart10.dev, kUartRxTimeoutUs) != 0)
      return 0;
#endif
  }
  if (device_is_ready(uart2.dev) &&
      uart_callback_set(uart2.dev, AsyncUart, &uart2) == 0 &&
      uart_hpm_rx_circular_enable(uart2.dev, uart2_ring, kRingBytes) == 0) {
    uart2.available = true;
    capabilities |= 4;
    k_thread_create(&uart_thread, uart_stack, K_THREAD_STACK_SIZEOF(uart_stack),
                    Uart2Loop, nullptr, nullptr, nullptr, 7, 0, K_NO_WAIT);
  }
#if DT_NODE_HAS_STATUS(DT_NODELABEL(uart3), okay)
  if (StartAsync(uart3)) {
    uart3.available = true;
    capabilities |= 16;
  }
#endif
  if (onboard.Init() == 0) {
    capabilities |= 8;
    k_thread_create(&imu_thread, imu_stack, K_THREAD_STACK_SIZEOF(imu_stack),
                    ImuLoop, nullptr, nullptr, nullptr, 4, 0, K_NO_WAIT);
  }
  k_thread_create(&tx_thread, tx_stack, K_THREAD_STACK_SIZEOF(tx_stack),
                  UartTransmitLoop, nullptr, nullptr, nullptr, 7, 0, K_NO_WAIT);
  return capabilities;
}
bool TakePeripheralFault() { return atomic_cas(&peripheral_fault, 1, 0); }
bool UartAvailable(uint8_t channel) {
  return channel >= 1 && channel <= 3 && ports[channel - 1] &&
         ports[channel - 1]->available;
}
int SubmitUart(uint8_t channel, const uint8_t *data, size_t length) {
  if (!UartAvailable(channel))
    return -ENODEV;
  if (!data || !length || length > wire::kMaxUartWrite)
    return -EINVAL;
  UartWrite write{};
  write.length = length;
  std::memcpy(write.data, data, length);
  k_mutex_lock(&tx_mutex, K_FOREVER);
  const int rc =
      k_msgq_put(&transmitters[channel - 1].queue, &write, K_NO_WAIT);
  if (rc)
    atomic_inc(&ports[channel - 1]->tx_errors);
  k_mutex_unlock(&tx_mutex);
  k_sem_give(&tx_wake);
  return rc ? -ENOSPC : 0;
}
void DiscardUartWrites() {
  k_mutex_lock(&tx_mutex, K_FOREVER);
  for (unsigned i = 0; i < 3; ++i) {
    k_msgq_purge(&transmitters[i].queue);
    if (ports[i] && atomic_get(&transmitters[i].busy)) {
      if (uart_tx_abort(ports[i]->dev))
        atomic_inc(&ports[i]->tx_errors);
    }
  }
  k_mutex_unlock(&tx_mutex);
}
UartStats ReadUartStats(uint8_t channel) {
  UartStats stats{};
  if (!UartAvailable(channel))
    return stats;
  const auto &port = *ports[channel - 1];
  stats.received = atomic_get(&port.received);
  stats.dropped = atomic_get(&port.dropped);
  stats.tx_completed = atomic_get(&port.tx_completed);
  stats.tx_errors = atomic_get(&port.tx_errors);
  return stats;
}
} // namespace gateway
```

## src/peripherals.h
```c
/* SPDX-License-Identifier: Apache-2.0 */
#pragma once
#include <dust_adapter/protocol.hpp>
namespace gateway {
uint32_t Session();
bool PublishPeripheral(const dust::wire::Packet &);
// Capability bits: CAN=1, UART10=2, UART2=4, onboard raw IMU=8, UART3=16.
uint32_t StartPeripherals();
bool TakePeripheralFault();
bool UartAvailable(uint8_t channel);
int SubmitUart(uint8_t channel, const uint8_t *data, size_t length);
void DiscardUartWrites();
struct UartStats {
  uint32_t received, dropped, tx_completed, tx_errors;
};
UartStats ReadUartStats(uint8_t channel);
} // namespace gateway
```
