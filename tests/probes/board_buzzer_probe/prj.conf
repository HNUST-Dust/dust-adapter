## CMakeLists.txt
```
cmake_minimum_required(VERSION 3.20.0)
include(${CMAKE_CURRENT_LIST_DIR}/../../../cmake/prepare.cmake)
find_package(Zephyr REQUIRED HINTS $ENV{ZEPHYR_BASE})
project(board_buzzer_probe)
target_include_directories(app PRIVATE ${ADAPTER_ROOT}/src)
target_sources(app PRIVATE src/main.c ${ADAPTER_ROOT}/src/drivers/pwm/buzzer.c ${ADAPTER_ROOT}/src/drivers/pwm/board_pwm.c)
```

## prj.conf
```kconfig
CONFIG_PWM=y
CONFIG_CONSOLE=y
CONFIG_SERIAL=y
CONFIG_UART_CONSOLE=n
CONFIG_USE_SEGGER_RTT=y
CONFIG_RTT_CONSOLE=y
CONFIG_LOG=n
CONFIG_MAIN_STACK_SIZE=2048
```

## src/main.c
```c
#include <zephyr/kernel.h>
#include <zephyr/sys/printk.h>
#include "drivers/pwm/buzzer.h"
int main(void)
{
    int rc = buzzer_init();
    if (rc) { printk("buzzer init failed: %d\n", rc); return 1; }
    printk("buzzer: 4 kHz, 100 ms every 2 s\n");
    for (;;) {
        rc = buzzer_beep(100);
        if (rc) { printk("buzzer pulse failed: %d\n", rc); return 1; }
        k_sleep(K_SECONDS(2));
    }
}
```
